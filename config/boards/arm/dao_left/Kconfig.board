## config/boards/arm/dao_left/Kconfig.board
```kconfig
# Copyright (c) 2021 Rafael Yumagulov
# SPDX-License-Identifier: MIT

config BOARD_DAO_LEFT
	bool "dao_left"
	depends on SOC_NRF52840_QIAA
```

## config/boards/arm/dao_left/Kconfig.defconfig
```kconfig
# Copyright (c) 2021 Rafael Yumagulov
# SPDX-License-Identifier: MIT

if BOARD_DAO_LEFT

config BOARD
	default "dao_left"

config ZMK_SPLIT
	default y

config BT_CTLR
	default BT

config ZMK_BATTERY_VOLTAGE_DIVIDER
	default y

if USB

config USB_NRFX
	default y

config USB_DEVICE_STACK
	default y

endif # USB

endif # BOARD_DAO_LEFT
```

## config/boards/arm/dao_left_peripheral/Kconfig.board
```kconfig
# Copyright (c) 2021 Rafael Yumagulov
# SPDX-License-Identifier: MIT

config BOARD_DAO_LEFT_PERIPHERAL
	bool "dao_left_peripheral"
	depends on SOC_NRF52840_QIAA
```

## config/boards/arm/dao_right/Kconfig.board
```kconfig
# Copyright (c) 2021 Rafael Yumagulov
# SPDX-License-Identifier: MIT

config BOARD_DAO_RIGHT
	bool "dao_right"
	depends on SOC_NRF52840_QIAA
```

## config/boards/dao/dao_right/Kconfig.dao_right
```kconfig
# Copyright (c) 2021 Rafael Yumagulov
# SPDX-License-Identifier: MIT

config BOARD_DAO_RIGHT
	select SOC_NRF52840_QIAA
	imply RETAINED_MEM
	imply RETENTION
	imply RETENTION_BOOT_MODE
```

## config/boards/dao/dao_right/Kconfig.defconfig
```kconfig
# Copyright (c) 2021 Rafael Yumagulov
# SPDX-License-Identifier: MIT

if BOARD_DAO_RIGHT

config ZMK_SPLIT
	default y

config ZMK_BATTERY_VOLTAGE_DIVIDER
	default y

if USB_DEVICE_DRIVER

config USB_NRFX
	default y

endif # USB_DEVICE_DRIVER

config BT_CTLR
	default BT

endif # BOARD_DAO_RIGHT
```

## config/boards/shields/dao_dongle/Kconfig.shield
```kconfig
# Copyright (c) 2021 Rafael Yumagulov
# SPDX-License-Identifier: MIT

config SHIELD_DAO_DONGLE
    def_bool $(shields_list_contains,dao_dongle)
```
